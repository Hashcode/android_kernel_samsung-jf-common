## arch/arm/configs/jf_vzw_defconfig
```kconfig
CONFIG_MACH_JF_VZW=y
CONFIG_EXTRA_FIRMWARE="audience-es325-fw-vzw.bin"
CONFIG_EXTRA_FIRMWARE_DIR="firmware"
CONFIG_AUTHENTEC_VPNCLIENT_INTERCEPTOR=y
#VMWARE RELATED
CONFIG_VMWARE_MVP=y
```
